## Kconfig
```kconfig
source "$APPSDIR/modbus/Kconfig"
source "$APPSDIR/nshlib/Kconfig"
source "$APPSDIR/platform/Kconfig"
source "$APPSDIR/fsutils/Kconfig"
source "$APPSDIR/netutils/Kconfig"
source "$APPSDIR/system/Kconfig"
```

## fsutils/Kconfig
```kconfig
menu "File System Utilities"
source "$APPSDIR/fsutils/mksmartfs/Kconfig"
source "$APPSDIR/fsutils/ipcfg/Kconfig"
source "$APPSDIR/fsutils/flash_eraseall/Kconfig"
source "$APPSDIR/fsutils/mkmbr/Kconfig"
source "$APPSDIR/fsutils/mkgpt/Kconfig"
source "$APPSDIR/fsutils/mkfatfs/Kconfig"
source "$APPSDIR/fsutils/inifile/Kconfig"
source "$APPSDIR/fsutils/inih/Kconfig"
source "$APPSDIR/fsutils/passwd/Kconfig"
endmenu
```

## netutils/Kconfig
```kconfig
menu "Network Utilities"
source "$APPSDIR/netutils/netcat/Kconfig"
source "$APPSDIR/netutils/netinit/Kconfig"
source "$APPSDIR/netutils/esp8266/Kconfig"
source "$APPSDIR/netutils/telnetc/Kconfig"
source "$APPSDIR/netutils/discover/Kconfig"
source "$APPSDIR/netutils/xmlrpc/Kconfig"
source "$APPSDIR/netutils/iperf/Kconfig"
source "$APPSDIR/netutils/chat/Kconfig"
source "$APPSDIR/netutils/rexec/Kconfig"
source "$APPSDIR/netutils/ntpclient/Kconfig"
source "$APPSDIR/netutils/codecs/Kconfig"
source "$APPSDIR/netutils/telnetd/Kconfig"
source "$APPSDIR/netutils/rexecd/Kconfig"
source "$APPSDIR/netutils/thttpd/Kconfig"
source "$APPSDIR/netutils/smtp/Kconfig"
source "$APPSDIR/netutils/pppd/Kconfig"
source "$APPSDIR/netutils/ping/Kconfig"
source "$APPSDIR/netutils/ftpc/Kconfig"
source "$APPSDIR/netutils/dhcpc/Kconfig"
source "$APPSDIR/netutils/wakeonlan/Kconfig"
source "$APPSDIR/netutils/libcurl4nx/Kconfig"
source "$APPSDIR/netutils/dhcpd/Kconfig"
source "$APPSDIR/netutils/mqttc/Kconfig"
source "$APPSDIR/netutils/ftpd/Kconfig"
source "$APPSDIR/netutils/tftpc/Kconfig"
source "$APPSDIR/netutils/dhcp6c/Kconfig"
source "$APPSDIR/netutils/netlib/Kconfig"
source "$APPSDIR/netutils/webserver/Kconfig"
source "$APPSDIR/netutils/cjson/Kconfig"
source "$APPSDIR/netutils/usrsock_rpmsg/Kconfig"
source "$APPSDIR/netutils/webclient/Kconfig"
endmenu
```

## system/Kconfig
```kconfig
menu "System Libraries and NSH Add-Ons"
source "$APPSDIR/system/vi/Kconfig"
source "$APPSDIR/system/taskset/Kconfig"
source "$APPSDIR/system/nxlooper/Kconfig"
source "$APPSDIR/system/zmodem/Kconfig"
source "$APPSDIR/system/gcov/Kconfig"
source "$APPSDIR/system/lm75/Kconfig"
source "$APPSDIR/system/trace/Kconfig"
source "$APPSDIR/system/composite/Kconfig"
source "$APPSDIR/system/cu/Kconfig"
source "$APPSDIR/system/system/Kconfig"
source "$APPSDIR/system/ping6/Kconfig"
source "$APPSDIR/system/readline/Kconfig"
source "$APPSDIR/system/dmalloc/Kconfig"
source "$APPSDIR/system/input/Kconfig"
source "$APPSDIR/system/nxrecorder/Kconfig"
source "$APPSDIR/system/flash_eraseall/Kconfig"
source "$APPSDIR/system/argtable3/Kconfig"
source "$APPSDIR/system/uorb/Kconfig"
source "$APPSDIR/system/setlogmask/Kconfig"
source "$APPSDIR/system/psmq/Kconfig"
source "$APPSDIR/system/embedlog/Kconfig"
source "$APPSDIR/system/netdb/Kconfig"
source "$APPSDIR/system/i2c/Kconfig"
source "$APPSDIR/system/lzf/Kconfig"
source "$APPSDIR/system/tee/Kconfig"
source "$APPSDIR/system/dumpstack/Kconfig"
source "$APPSDIR/system/popen/Kconfig"
source "$APPSDIR/system/mdio/Kconfig"
source "$APPSDIR/system/cle/Kconfig"
source "$APPSDIR/system/ntpc/Kconfig"
source "$APPSDIR/system/hexed/Kconfig"
source "$APPSDIR/system/ping/Kconfig"
source "$APPSDIR/system/dhcpc/Kconfig"
source "$APPSDIR/system/adb/Kconfig"
source "$APPSDIR/system/cdcacm/Kconfig"
source "$APPSDIR/system/ubloxmodem/Kconfig"
source "$APPSDIR/system/telnet/Kconfig"
source "$APPSDIR/system/termcurses/Kconfig"
source "$APPSDIR/system/nxplayer/Kconfig"
source "$APPSDIR/system/spi/Kconfig"
source "$APPSDIR/system/usbmsc/Kconfig"
source "$APPSDIR/system/sched_note/Kconfig"
source "$APPSDIR/system/nsh/Kconfig"
source "$APPSDIR/system/ramtest/Kconfig"
source "$APPSDIR/system/hostname/Kconfig"
source "$APPSDIR/system/ramspeed/Kconfig"
source "$APPSDIR/system/hex2bin/Kconfig"
source "$APPSDIR/system/critmon/Kconfig"
source "$APPSDIR/system/cfgdata/Kconfig"
source "$APPSDIR/system/uniqueid/Kconfig"
source "$APPSDIR/system/libuv/Kconfig"
source "$APPSDIR/system/stackmonitor/Kconfig"
endmenu
```
